## ESP32-44net-Tester/main/Kconfig.projbuild
```kconfig
menu "44net Tester"

config TESTER_AP_SSID
    string "Provisioning AP SSID"
    default "44net-tester-setup"
    help
      SSID raised when no credentials are stored or when joining fails. The
      AP is open by design: it exists only during short recovery windows.

config TESTER_PORTAL_TIMEOUT_S
    int "Portal window before reboot (seconds)"
    default 600
    help
      How long the provisioning portal stays up before rebooting and retrying
      the stored credentials. Bounded on purpose: a transient AP outage must
      not park the device in AP mode forever at a remote site.

config TESTER_STA_MAX_RETRY
    int "Join attempts before falling back to the portal"
    default 3

config TESTER_BOOT_GPIO
    int "GPIO of the BOOT button"
    default 0
    help
      0 on ESP32 and ESP32-S3, 9 on ESP32-C3.

      Held for three seconds DURING OPERATION it erases the stored network and
      reboots into the portal. It is deliberately not read at reset: the ROM
      bootloader samples GPIO0 there and enters serial download mode when it is
      low, so a button checked at reset is invisible to the application.

config TESTER_UDP_PORT
    int "UDP port to listen on"
    default 5000
    help
      Answers test 4 of docs/test-procedure.md, which probes an allowed UDP
      port. Arrivals are recorded (headers only) and shown on the status page.

config TESTER_HTTP_PORT
    int "TCP port for the status pages"
    default 8044
    help
      Deliberately not 80. Port 80 is the most heavily scanned port on the
      internet, and a 44net allocation is public space. Moving off it cuts the
      background noise; it is not concealment, and it is not a substitute for
      keeping the port closed except during a test.

config TESTER_OTA_ENABLE
    bool "Enable pulling firmware updates"
    default y
    help
      The device fetches the image itself over TLS. Nothing is pushed to it, so
      no inbound port is needed for updates.

      Requires outbound internet from the segment. A site whose 44net segment
      reaches only 44net cannot use this - flash over serial instead.

config TESTER_UPDATE_URL
    string "URL of the firmware image to fetch"
    default "https://github.com/swissdigitalnet/44-net/releases/latest/download/esp32-44net-tester.bin"
    depends on TESTER_OTA_ENABLE
    help
      Triggered by GET /update, which is refused unless the caller is on the
      same segment - so an update cannot be started from the open internet even
      while a test window has the port open.

config TESTER_CHECK_44NET
    string "A 44net host to try reaching (blank to skip)"
    default ""
    help
      Answers "can this segment reach 44net at all". Tried on tcp/80.

config TESTER_CHECK_INTERNAL
    string "An internal host that must NOT be reachable (blank to skip)"
    default ""
    help
      Test 7 of docs/test-procedure.md - the rule that makes the segment a DMZ.
      Tried on tcp/80; a result other than "blocked" means your isolation is
      not holding.

config TESTER_CHECK_INTERNET
    string "An internet host to try reaching (blank to skip)"
    default "1.1.1.1"
    help
      Informational: whether the segment has outbound internet. Tried on
      tcp/53. Either answer can be correct depending on how you scoped egress.

endmenu
```
